/dts-v1/;
/plugin/;

/ {
    fragment@0 {
        target-path = "/";
        __overlay__ {
            my_motor_device {
                compatible = "slend,super-motor";
                front-gpios = <&main_gpio1 15 0>; 
                back-gpios = <&main_gpio1 17 0>; 
                move-gpios = <&main_gpio1 18 0>;
                status = "okay";
            };
            
        };
    };
};
