/dts-v1/;
/plugin/;

/ {
    fragment@0 {
        target-path = "/";
        __overlay__ {
            my_speed_device {
                compatible = "slend,super-speed";
                speed-gpios = <&main_gpio1 8 0>;
                status = "okay";
            };
        };
    };
};
